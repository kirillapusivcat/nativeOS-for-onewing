#include <Wire.h>
#include "Arduino.h"
#include "DFRobotDFPlayerMini.h"
#include <Adafruit_GFX.h>
#include <Adafruit_SSD1306.h>
#include <RTClib.h>

// init

#define SCREEN_WIDTH 128
#define SCREEN_HEIGHT 64
#define OLED_RESET -1

#ifdef ESP32
  #define FPSerial Serial1
#else
  #include <SoftwareSerial.h>
  SoftwareSerial FPSerial(16, 17);
#endif

DFRobotDFPlayerMini player;
Adafruit_SSD1306 display(SCREEN_WIDTH, SCREEN_HEIGHT, &Wire, OLED_RESET);
RTC_DS3231 rtc;

const int abtnpin = 5;
const int bbtnpin = 4;
const int cbtnpin = 12;
const int dbtnpin = 14;

int abtnact;
int bbtnact;
int cbtnact;
int dbtnact;

// modes
int Displaysts = HIGH;
int MODE = 0;
int APP = 0;

// time

String rtcseconds;
String rtcminutes;
String rtchours;
String rtcdays;
String rtcmonths;
String rtcyears;

// months names
String month_name;
String month_names[12]={"Jan", "Feb", "March", "April", "May", "June", "July", "Aug", "Sep", "Oct", "Nov", "Dec"};

void get_month_name(int month_int) {
  month_name = month_names[month_int - 1];
}

// fls

int DFPlayerrd;

//Apps

void openApp(int appnum;) {
  APP = MODE
}

// bitmap imgs

//BOOT_IMG_INIT

// 1YANVS
static const uint8_t image_data_1YANVS[1024] = {
    0xff, 0xff, 0xff, 0xff, 0xff, 0xff, 0xff, 0x7f, 0xff, 0x7f, 0xff, 0xff, 0xff, 0xff, 0xff, 0xff, 
0xff, 0xff, 0xff, 0xff, 0xff, 0xff, 0xea, 0xff, 0xfd, 0xaf, 0xff, 0xff, 0xff, 0xff, 0xff, 0xff, 
0xff, 0xff, 0xff, 0xff, 0xff, 0xfe, 0xb5, 0x5f, 0xf5, 0x75, 0xff, 0xff, 0xff, 0xff, 0xff, 0xff, 
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0xff, 0xff, 0xff, 0xff, 0xff, 0xff, 0xff, 0xff, 0xff, 0xff, 0xff, 0xff, 0xff, 0xff, 0xff, 0xff
};

// BOOTSCREEN

static const uint8_t image_data_BOOT[1024] = {
    0xff, 0xff, 0xff, 0xff, 0xff, 0xff, 0xff, 0xff, 0xff, 0xff, 0xff, 0xff, 0xff, 0xff, 0xff, 0xff, 
0xff, 0xff, 0xff, 0xff, 0xff, 0xff, 0xff, 0xff, 0xff, 0xff, 0xff, 0xff, 0xff, 0xff, 0xff, 0xff, 
0xff, 0xff, 0xff, 0xff, 0xff, 0xff, 0xff, 0xff, 0xff, 0xff, 0xff, 0xff, 0xff, 0xff, 0xff, 0xff, 
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0xff, 0xff, 0xff, 0xff, 0xff, 0xff, 0xff, 0xff, 0xff, 0xff, 0xff, 0xff, 0xff, 0xff, 0xff, 0xfb
};

// BOOT Setup

void setup() {
    pinMode(abtnpin, INPUT_PULLUP);
    pinMode(bbtnpin, INPUT_PULLUP);
    pinMode(cbtnpin, INPUT_PULLUP);
    pinMode(dbtnpin, INPUT_PULLUP);
    Serial.begin(115200);
    Wire.begin();

    #ifdef ESP32
      FPSerial.begin(9600, SERIAL_8N1, 16, 17);
    #else
      FPSerial.begin(9600);
    #endif

    if (!player.begin(FPSerial)) {
    Serial.println(F("Unable to begin ERROR CODE:444650"));
    while(true);
  }
  if (DFPlayerrd != LOW) {
    DFPlayerrd = HIGH;
  }
  
    if (!rtc.begin()) {
      Serial.println("Unable to begin ERROR CODE: 828467");
      while(true);
    }

    player.volume(20);

    display.begin(SSD1306_SWITCHCAPVCC, 0x3C);
    display.clearDisplay();

    // 1 YANVS display
    display.drawBitmap(0, 0, image_data_1YANVS, 128, 64, 1);
    display.display();
    player.play(2);
    delay(3000);
    display.clearDisplay();
    
    // BOOT_IMAGE display
    display.drawBitmap(0, 0, image_data_BOOT, 128, 64, 1);
    display.display();
    player.play(1);
    delay(5000);
    display.clearDisplay();

    // welcome back text
    display.setTextSize(2);
    display.setTextColor(WHITE);
    display.setCursor(0, 10);
    display.println("Welcome back!");
    display.display();
    player.play(2);
    delay(2000);
    display.clearDisplay();

    // BOOT_END
}

// OS Loop

void loop() {
  // time init
  DateTime now = rtc.now();

  if (now.minute() < 10) {
    rtcminutes = "0" + String(now.minute());
  } else {
    rtcminutes = String(now.minute());
  }

  if (now.second() < 10) {
    rtcseconds = "0" + String(now.second());
  } else {
    rtcseconds = String(now.second());
  }

  rtchours = String(now.hour());
  rtcdays = String(now.day());
  rtcmonths = String(now.month());
  get_month_name(now.month());
  rtcyears = String(now.year());

  // App prewiew
  if (Displaysts == HIGH) {
    if (MODE == 0 && APP == 0) {
      display.clearDisplay();
      display.setTextSize(2);
      display.setTextColor(SSD1306_WHITE);
      display.setCursor(0,20);
      display.print(String(now.hour()) + ":" + rtcminutes + ":" + rtcseconds);
      display.setTextSize(1);
      display.setCursor(0,50);
      display.print(rtcdays + " " + month_name + " " + rtcyears);
      display.display();
    } else {
      display.clearDisplay();
      display.setTextSize(2);
      display.setTextColor(SSD1306_WHITE);
      display.setCursor(0,10);
      display.print(MODE);
      display.setTextSize(2);
      display.setCursor(32,32);
      display.print("Blank");
      display.display();
    }
  } else if (Displaysts == LOW) {
    display.clearDisplay();
    display.display();
  }

  // read keypad value
  
  abtnact = digitalRead(abtnpin);
  bbtnact = digitalRead(bbtnpin);
  cbtnact = digitalRead(cbtnpin);
  dbtnact = digitalRead(dbtnpin);

  if (bbtnact == 0 && MODE == 0) {
    if (Displaysts == HIGH){
      Displaysts = LOW;
    } else if (Displaysts == LOW) {
      Displaysts = HIGH;
    }
  } else if (bbtnact == 0 && MODE != 0 && APP == 0) {
    openApp(MODE);
  }

  if (abtnact == 0 && Displaysts == HIGH && APP == 0) {
    MODE++;
  } else if (cbtnact == 0 && MODE != 0 && Displaysts == HIGH && APP == 0) {
    MODE--;
  }

  if (dbtnact == 0) {
    MODE = 0;
    APP = 0;
  }

  delay(200);

}